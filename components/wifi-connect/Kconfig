## components/wifi-connect/Kconfig
```kconfig
menu "Default WiFi configuration"

config DEFAULT_WIFI_SSID
    string "WiFi SSID"
    default "default_ssid"
    help
        Default SSID for the WiFi network.

config DEFAULT_WIFI_PASSWORD
    string "WiFi password"
    default "default_password"
    help
        Default password for the WiFi network.

endmenu
    
```

## main/Kconfig
```kconfig
menu "Main configuration"


config MEMORY_TRACE_ENABLED
    bool "Enable heap tracing"
    default n
    help
        Enable heap tracing for memory allocation and deallocation

endmenu
    
```
